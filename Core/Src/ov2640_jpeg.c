/*
 * ov2640_jpeg.c
 *
 *  Created on: Aug 17, 2024
 *      Author: user
 */

#include "ov2640_jpeg.h"
#include "i2c.h"
#include "usart.h"
#include "dcmi.h"
#include <string.h>
#include <stdio.h>

uint8_t pictureBuff[JPEG_BUFF_SIZE];

uint8_t uart_message[256];
uint32_t uart_size;

const unsigned char OV2640_JPEG_INIT[][2] =
{
{ 0xff, 0x00 },
{ 0x2c, 0xff },
{ 0x2e, 0xdf },
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{ 0x5c, 0x00 }, };

const unsigned char OV2640_YUV422[][2] =
{
{ 0xFF, 0x00 },
{ 0x05, 0x00 },
{ 0xDA, 0x10 },
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{ 0x00, 0x00 }, };

const unsigned char OV2640_JPEG[][2] =
{
{ 0xe0, 0x14 },
{ 0xe1, 0x77 },
{ 0xe5, 0x1f },
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{ 0x04, 0xF8 }, };

const unsigned char OV2640_1280x960_JPEG[][2] =
{
{ 0xFF, 0x01 },
{ 0x11, 0x01 },
{ 0x12, 0x00 },
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{ 0xe0, 0x00 }, };

uint8_t OV2640_Mem_Write(uint8_t reg, uint8_t camera_tx)
{
	uint8_t camera_rx;
	HAL_I2C_Mem_Write(OV2640_I2C, OV2640_ADDR, reg, I2C_MEMADD_SIZE_8BIT,
			&camera_tx, 1, 100);
	HAL_Delay(10);
	HAL_I2C_Mem_Read(OV2640_I2C, OV2640_ADDR, reg, I2C_MEMADD_SIZE_8BIT,
			&camera_rx, 1, 100);
	if (camera_rx == camera_tx)
	{
		HAL_UART_Transmit(OV2640_DEBUG_UART, (uint8_t*) "I2C write OK.\r\n",
				strlen("I2C write OK.\r\n"), 1000);
		return 0;
	}
	else
	{
		HAL_UART_Transmit(OV2640_DEBUG_UART, (uint8_t*) "I2C write ERROR!\r\n",
				strlen("I2C write ERROR!\r\n"), 1000);
		return 1;
	}
}

uint16_t OV2640_Init_JPEG(void)
{
	uint16_t number_of_errors = 0;
	HAL_UART_Transmit(OV2640_DEBUG_UART, (uint8_t*) "\x1B[2J\x1B[H",
			sizeof("\x1B[2J\x1B[H"), 1000);

	HAL_UART_Transmit(OV2640_DEBUG_UART,
			(uint8_t*) "Executing OV2640_Init_JPEG()\r\n",
			strlen("Executing OV2640_Init_JPEG()\r\n"), 1000);

	HAL_UART_Transmit(OV2640_DEBUG_UART, (uint8_t*) "Resetting OV2640\r\n",
			strlen("Resetting OV2640\r\n"), 1000);

	HAL_GPIO_WritePin(OV2640_PWDN_GPIO_Port, OV2640_PWDN_Pin, GPIO_PIN_RESET); // power ON
	HAL_Delay(5);
	HAL_GPIO_WritePin(OV2640_RST_GPIO_Port, OV2640_RST_Pin, GPIO_PIN_RESET); // hardware reset
	HAL_Delay(5);
	HAL_GPIO_WritePin(OV2640_RST_GPIO_Port, OV2640_RST_Pin, GPIO_PIN_SET);
	HAL_Delay(5);

	// Enter camera configuration mode
	HAL_UART_Transmit(OV2640_DEBUG_UART,
			(uint8_t*) "Entering configuration mode\r\n",
			strlen("Entering configuration mode\r\n"), 1000);
	number_of_errors += OV2640_Mem_Write(OV2640_DSP_RA_DLMT, 0x01);
	HAL_Delay(5);
	number_of_errors += OV2640_Mem_Write(OV2640_SENSOR_COM7, 0x80);
	HAL_Delay(40);

	HAL_UART_Transmit(OV2640_DEBUG_UART, (uint8_t*) "OV2640_JPEG_INIT\r\n",
			strlen("OV2640_JPEG_INIT\r\n"), 1000);

	for (uint16_t i = 0; i < sizeof(OV2640_JPEG_INIT) / 2; i++)
	{
		number_of_errors += OV2640_Mem_Write(OV2640_JPEG_INIT[i][0],
				OV2640_JPEG_INIT[i][1]);
		HAL_Delay(5);
	}

	HAL_UART_Transmit(OV2640_DEBUG_UART, (uint8_t*) "OV2640_YUV422\r\n",
			strlen("OV2640_YUV422\r\n"), 1000);
	for (uint16_t i = 0; i < sizeof(OV2640_YUV422) / 2; i++)
	{
		number_of_errors += OV2640_Mem_Write(OV2640_YUV422[i][0],
				OV2640_YUV422[i][1]);
		HAL_Delay(5);
	}
	HAL_UART_Transmit(OV2640_DEBUG_UART, (uint8_t*) "OV2640_JPEG\r\n",
			strlen("OV2640_JPEG\r\n"), 1000);

	for (uint16_t i = 0; i < sizeof(OV2640_JPEG) / 2; i++)
	{
		number_of_errors += OV2640_Mem_Write(OV2640_JPEG[i][0],
				OV2640_JPEG[i][1]);
		HAL_Delay(5);
	}
	HAL_UART_Transmit(OV2640_DEBUG_UART, (uint8_t*) "OV2640_1280x960_JPEG\r\n",
			strlen("OV2640_1280x960_JPEG\r\n"), 1000);

	for (uint16_t i = 0; i < sizeof(OV2640_1280x960_JPEG) / 2; i++)
	{
		number_of_errors += OV2640_Mem_Write(OV2640_1280x960_JPEG[i][0],
				OV2640_1280x960_JPEG[i][1]);
		HAL_Delay(5);
	}
	HAL_UART_Transmit(OV2640_DEBUG_UART,
			(uint8_t*) "Exiting OV2640_Init_JPEG()\r\n",
			strlen("Exiting OV2640_Init_JPEG()\r\n"), 1000);
	return number_of_errors;

}

uint8_t OV2640_TakePicture(uint32_t *_jpeg_begin, uint32_t *_jpeg_end)
{

	uint32_t timeout = 0;

	uint8_t header_found_flag = 0;
	*_jpeg_begin = 0;
	*_jpeg_end = 0;

	memset(pictureBuff, 0, JPEG_BUFF_SIZE);

	HAL_DCMI_Start_DMA(&hdcmi, DCMI_MODE_SNAPSHOT, (uint32_t) pictureBuff,
	JPEG_BUFF_SIZE / 4);
	while ((hdcmi.Instance->CR & 0x03) == 3)
	{
		if (timeout > 1000) //max timeout: 10 seconds
		{
			HAL_UART_Transmit(OV2640_DEBUG_UART,
					(uint8_t*) "JPEG photo timeout\r\n",
					strlen("JPEG photo timeout\r\n"), 1000);
			return 2;
		}
		HAL_Delay(10);
		timeout++;
	}

	for (int idx = 0; idx < JPEG_BUFF_SIZE; idx++)
	{
		if (header_found_flag == 0 && pictureBuff[idx] == 0xff
				&& pictureBuff[idx + 1] == 0xD8)
		{
			header_found_flag = 1;
			*_jpeg_begin = idx;
		}

		if (header_found_flag == 1 && pictureBuff[idx] == 0xFF
				&& pictureBuff[idx + 1] == 0xD9)
		{
			header_found_flag = 0;
			*_jpeg_end = idx + 1;

			uart_size = sprintf((char*) uart_message,
					"JPEG photo OK. Size: %lu bytes.\r\n",
					*_jpeg_end - *_jpeg_begin + 1);

			HAL_UART_Transmit(OV2640_DEBUG_UART, uart_message, uart_size, 1000);
			return 0;
		}
	}
	return 1;
}
